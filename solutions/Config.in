## solutions/Config.in
```kconfig
menu "Eudyptula"

source "$BR2_EXTERNAL_EUDYPTULA_PATH/package/Config.in"

endmenu
```

## solutions/configs/eudyptula_qemu_x86_64_defconfig
```kconfig
BR2_x86_64=y
BR2_BINUTILS_VERSION_2_44_X=y
BR2_GCC_VERSION_14_X=y
BR2_WGET="wget --passive-ftp -nd -t 3"
BR2_SVN="svn --non-interactive"
BR2_SCP="scp"
BR2_SFTP="sftp"
BR2_DL_DIR="$(BR2_EXTERNAL_EUDYPTULA_PATH)/../dl"
BR2_BACKUP_SITE="http://sources.buildroot.net"
BR2_GNU_MIRROR="http://ftpmirror.gnu.org"
BR2_CCACHE=y
BR2_OPTIMIZE_S=y
BR2_GLOBAL_PATCH_DIR="$(BR2_EXTERNAL_EUDYPTULA_PATH)/patches"
BR2_DOWNLOAD_FORCE_CHECK_HASHES=y
BR2_REPRODUCIBLE=y
BR2_PER_PACKAGE_DIRECTORIES=y
BR2_TARGET_GENERIC_HOSTNAME="Eudyptula"
BR2_TARGET_GENERIC_ISSUE="Welcome to Buildroot-Eudyptula"
BR2_INIT_SYSV=y
BR2_ROOTFS_DEVICE_CREATION_DYNAMIC_EUDEV=y
BR2_SYSTEM_DHCP="eth0"
BR2_ROOTFS_OVERLAY="$(BR2_EXTERNAL_EUDYPTULA_PATH)/board/rootfs-overlay/"
BR2_ROOTFS_POST_BUILD_SCRIPT="board/qemu/x86_64/post-build.sh"
BR2_ROOTFS_POST_IMAGE_SCRIPT="board/qemu/post-image.sh"
BR2_ROOTFS_POST_SCRIPT_ARGS="$(BR2_DEFCONFIG)"
BR2_LINUX_KERNEL=y
BR2_LINUX_KERNEL_USE_CUSTOM_CONFIG=y
BR2_LINUX_KERNEL_CUSTOM_CONFIG_FILE="$(BR2_EXTERNAL_EUDYPTULA_PATH)/board/eudyptula/linux.config"
BR2_LINUX_KERNEL_CONFIG_FRAGMENT_FILES="$(BR2_EXTERNAL_EUDYPTULA_PATH)/package/solution-2/eudyptula-localversion.cfg $(BR2_EXTERNAL_EUDYPTULA_PATH)/configs/fragments/usb-announce-new-devices.cfg $(BR2_EXTERNAL_EUDYPTULA_PATH)/configs/fragments/usb-qemu-kbd.cfg $(BR2_EXTERNAL_EUDYPTULA_PATH)/configs/fragments/enable-debugfs.cfg"
BR2_LINUX_KERNEL_NEEDS_HOST_LIBELF=y
BR2_PACKAGE_LSOF=y
BR2_PACKAGE_EUDEV_RULES_GEN=y
BR2_TARGET_ROOTFS_EXT2=y
# BR2_TARGET_ROOTFS_TAR is not set
BR2_PACKAGE_HOST_QEMU=y
BR2_PACKAGE_HOST_QEMU_SYSTEM_MODE=y
BR2_PACKAGE_SOLUTION_1=y
BR2_PACKAGE_SOLUTION_4=y
BR2_PACKAGE_SOLUTION_6=y
BR2_PACKAGE_SOLUTION_8=y
BR2_PACKAGE_HELLO=y
```

## solutions/package/Config.in
```kconfig
# Solutions

# Solution for challenge #1
source "$BR2_EXTERNAL_EUDYPTULA_PATH/package/solution-1/Config.in"

# Solution for challenge #4
source "$BR2_EXTERNAL_EUDYPTULA_PATH/package/solution-4/Config.in"

# Solution for challenge #6
source "$BR2_EXTERNAL_EUDYPTULA_PATH/package/solution-6/Config.in"

# Solution for challenge #8
source "$BR2_EXTERNAL_EUDYPTULA_PATH/package/solution-8/Config.in"

# hello
source "$BR2_EXTERNAL_EUDYPTULA_PATH/package/hello/Config.in"
```

## solutions/package/hello/Config.in
```kconfig
config BR2_PACKAGE_HELLO
    bool "hello"
    default n
    depends on BR2_LINUX_KERNEL
    help
        Solution for eudyptula challenge #1.
```

## solutions/package/solution-1/Config.in
```kconfig
config BR2_PACKAGE_SOLUTION_1
    bool "solution #1"
    default n
    depends on BR2_LINUX_KERNEL
    help
        Solution for eudyptula challenge #1.
```

## solutions/package/solution-4/Config.in
```kconfig
config BR2_PACKAGE_SOLUTION_4
    bool "solution #4"
    default n
    depends on BR2_LINUX_KERNEL
    help
        Solution for eudyptula challenge #4 - fix styling issues for solution of challenge #1.
```

## solutions/package/solution-6/Config.in
```kconfig
config BR2_PACKAGE_SOLUTION_6
    bool "solution #6"
    default n
    depends on BR2_LINUX_KERNEL
    help
        Solution for eudyptula challenge #6 - a misc char device.
```

## solutions/package/solution-8/Config.in
```kconfig
config BR2_PACKAGE_SOLUTION_8
    bool "solution #8"
    default n
    depends on BR2_LINUX_KERNEL
    help
        Solution for eudyptula challenge #8 - driver with debugfs
```

## solutions/package/solution-9/Config.in
```kconfig
config BR2_PACKAGE_SOLUTION_9
    bool "solution #9"
    default n
    depends on BR2_LINUX_KERNEL
    help
        Solution for eudyptula challenge #9 - driver with sysfs
```
